/*******************************************************************************
 * ET-ESP32(WROVER) RS485 V3
 * Tools->Board:"ESP32 Wrover Module"
 *******************************************************************************
 * I2C Interface & I2C Bus
 * -> IO22                = I2C_SCL
 * -> IO21                = I2C_SDA
 * -> I2C RTC:DS3231      = I2C Address : 0x68:1100100(x)
 * -> I2C EEPROM 24LC16   = I2C Address : 0x50:1010000(x)
 * -> I2C ADC MCP3423     = I2C Address : 0x6D:1100101(x)
 * -> I2C Sensor:BME280   = I2C Address : 0x76:1110110(x)
 * -> I2C Sebsor:SHT31    = I2C Address : 0x44:1000100(x)/0x45:1010101(x)
 * SPI Interface SD Card
 * -> SD_CS               = IO4
 * -> SPI_MISO            = IO19
 * -> SPI_MOSI            = IO23
 * -> SPI_SCK             = IO18
 * UART2 RS485 Half Duplex Auto Direction
 * -> IO26                = RX2
 * -> IO27                = TX2
 * Led
 * -> IO2                 = LED Status
 * User Switch
 * -> IO36                = User Switch
 * Buzzer
 * -> IO32                = Buzzer
 * Opto Output
 * -> IO25                = Opto Output
 *******************************************************************************/
//=================================================================================================
// demo interface I2C Sensor
//=================================================================================================
// SHT31 Temperature + Humidity
// BH1750 Light Meter
//=================================================================================================

//=================================================================================================
#include <Wire.h> 
//=================================================================================================

//=================================================================================================
// Start of Default Hardware : ET-ESP32(WROVER) RS485 V3
//=================================================================================================
// Remap Pin USART -> C:\Users\Admin\Documents\Arduino\hardware\espressif\esp32\cores\esp32\HardwareSerial.cpp
//                    C:\Users\Admin\AppData\Local\Arduino15\packages\esp32\hardware\esp32\1.0.0\cores\esp32\HardwareSerial.cpp
//=================================================================================================
#include <HardwareSerial.h>
//=================================================================================================
#define serialDebug           Serial                                                              // USB Serial(Serial0)
//=================================================================================================
#define SerialRS485_RX_PIN    26
#define SerialRS485_TX_PIN    27
#define SerialRS485           Serial2                                                             // Serial2(IO27=TXD,IO26=RXD)
//=================================================================================================
#define SerialLora_RX_PIN     14
#define SerialLora_TX_PIN     13
#define SerialLora            Serial1                                                             // Serial1(IO13=TXD,IO14=RXD)
//=================================================================================================
#define LORA_RES_PIN          33                                                                  // ESP32-WROVER :IO33(LoRa-RESET)
#define LORA_RES_PRESS        LOW
#define LORA_RES_RELEASE      HIGH
//=================================================================================================
#define I2C_SCL_PIN           22                                                                  // ESP32-WROVER : IO22(SCL1)
#define I2C_SDA_PIN           21                                                                  // ESP32-WROVER : IO21(SDA1)
//=================================================================================================
#define LedPin                2                                                                   // ESP32-WROVER  : IO2
#define LedLogicOn            HIGH
#define LedLogicOff           LOW
#define InitialLed()          pinMode(LedPin,OUTPUT)
#define OnLed()               digitalWrite(LedPin, LedLogicOn)
#define OffLed()              digitalWrite(LedPin, LedLogicOff)
//=================================================================================================
#define UserSwitchPin         36                                                                  // ESP32-WROVER :IO36
#define SwLogicPress          LOW
#define SwLogicRelease        HIGH 
#define InitialUserSwitch()   pinMode(UserSwitchPin,INPUT_PULLUP)
//=================================================================================================
#define BuzzerPin             32                                                                  // ESP32-WROVER :IO32
#define BuzzerLogicOff        LOW
#define BuzzerLogicOn         HIGH 
#define InitialBuzzer()       pinMode(BuzzerPin,OUTPUT)
#define OnBuzzer()            digitalWrite(BuzzerPin, BuzzerLogicOn) 
#define OffBuzzer()           digitalWrite(BuzzerPin, BuzzerLogicOff)
//=================================================================================================
#define OptoOutputPin         25                                                                  // ESP32-WROVER : IO25
#define OptoOutputLogicOn     LOW
#define OptoOutputLogicOff    HIGH
#define InitialOptoOutput()   pinMode(OptoOutputPin,OUTPUT)
#define OnOptoOutput()        digitalWrite(OptoOutputPin, OptoOutputLogicOn)
#define OffOptoOutput()       digitalWrite(OptoOutputPin, OptoOutputLogicOff)
//=================================================================================================
// End of Default Hardware : ET-ESP32(WROVER) RS485 V3
//=================================================================================================

//=================================================================================================
#include "Adafruit_SHT31.h"
//=================================================================================================
Adafruit_SHT31 sht31 = Adafruit_SHT31();                                                          // I2C Sensor
//================================================================================================= 
#define max_sht31_temperature   125.0                                                             // (-)40..(+)125 (C")
#define min_sht31_temperature   -40.0
#define err_sht31Temperature    128.0
#define err_temperature         128.0
//=================================================================================================
#define max_sht31_humidity      100.0                                                             // 0..100(%RH)
#define min_sht31_humidity      0.0
#define err_sht31Humidity       128.0
//=================================================================================================
float sht31Temperature;
float sht31Humidity;
//=================================================================================================

//=================================================================================================
#include <BH1750.h>
//=================================================================================================
BH1750 lightMeter;
//=================================================================================================  
#define max_bh1750_light        54612.5                                                           // 0..54612.5(Lux)
#define min_bh1750_light        0.0
#define err_bh1750Light         65535.0
//=================================================================================================
float bh1750Lux;
//=================================================================================================

//=================================================================================================
unsigned long lastGetI2CTime = 0;
//=================================================================================================

void setup() 
{
  //===============================================================================================
  // Start of Initial Default Hardware : ET-ESP32(WROVER) RS485 V3
  //===============================================================================================
  Wire.begin(I2C_SDA_PIN,I2C_SCL_PIN);                                                      
  //===============================================================================================
  serialDebug.begin(115200);
  while(!serialDebug);
  //===============================================================================================
  SerialRS485.begin(9600, SERIAL_8N1, SerialRS485_RX_PIN, SerialRS485_TX_PIN);
  while(!SerialRS485);
  //===============================================================================================
  // End of Initial Default Hardware : ET-ESP32(WROVER) RS485 V3
  //===============================================================================================

  //===============================================================================================
  serialDebug.println(F("========================================================================="));
  serialDebug.println("ET-ESP32(WROVER)RS485 V3.....Start");
  serialDebug.println(F("========================================================================="));
  //===============================================================================================
  
  //===============================================================================================
  // Start of Search & Initial SHT31  
  //===============================================================================================
  // ADDR:LOW  = 0x44 
  // ADDR:HIGH = 0x45
  //===============================================================================================
  Wire.beginTransmission(0x44);                                                                   // SHT31 Slave Address = 0x44,0x45
  //===============================================================================================
  if(Wire.endTransmission () == 0)
  {
    //=============================================================================================
    serialDebug.println(F("========================================================================="));
    serialDebug.println(F("I2C Initial SHT31(0x44)...Start"));
    //=============================================================================================
    sht31.begin(0x44);
    //=============================================================================================
    sht31Temperature = sht31.readTemperature();                                                 // (-)55...(+)125
    sht31Humidity = sht31.readHumidity();                                                       // 0..100
    //=============================================================================================
    serialDebug.println(F("I2C Initial SHT31(0x44)...Complete"));
    serialDebug.print("I2C SHT31(0x44) Temperature = ");
    serialDebug.print(sht31Temperature,1);
    serialDebug.print(", Humidity = ");
    serialDebug.println(sht31Humidity,1);
    //==============================================================================================
    serialDebug.println(F("========================================================================="));
    serialDebug.println(F("I2C SHT31(0x44) : Temperature,Humidity...Install"));
    serialDebug.println(F("========================================================================="));
    //=============================================================================================
  }
  else
  {
    //=============================================================================================
    Wire.beginTransmission(0x45);                                                                 // SHT31 Slave Address = 0x44,0x45
    //=============================================================================================
    if(Wire.endTransmission () == 0)
    {
      //===========================================================================================
      serialDebug.println(F("I2C Initial SHT31(0x45)...Start"));
      //===========================================================================================
      sht31.begin(0x45);
      //===========================================================================================
      sht31Temperature = sht31.readTemperature();                                                 // (-)55...(+)125
      sht31Humidity = sht31.readHumidity();                                                       // 0..100
      //===========================================================================================
      serialDebug.println(F("I2C Initial SHT31(0x45)...Complete"));
      //===========================================================================================
      serialDebug.print("I2C SHT31(0x45) Temperature = ");
      serialDebug.print(sht31Temperature,1);
      serialDebug.print(", Humidity = ");
      serialDebug.println(sht31Humidity,1);
      //===========================================================================================
      serialDebug.println(F("========================================================================="));
      serialDebug.println(F("I2C SHT31(0x45) : Temperature,Humidity...Install"));
      serialDebug.println(F("========================================================================="));
      //===========================================================================================
    }
    else
    {
      //===========================================================================================
      serialDebug.println(F("I2C SHT31(0x44,0x45)...Not Install"));
      //===========================================================================================
      //===========================================================================================
      sht31Temperature = err_sht31Temperature;
      sht31Humidity = err_sht31Humidity;
      //===========================================================================================
      serialDebug.print("I2C SHT31(0x45) Temperature = ");
      serialDebug.print(sht31Temperature,1);
      serialDebug.print(", Humidity = ");
      serialDebug.println(sht31Humidity,1);
      //===========================================================================================
    }  
  }
  //===============================================================================================
  // End of Search & Initial SHT31  
  //===============================================================================================
  //===============================================================================================
  serialDebug.println(F("========================================================================="));
  //===============================================================================================

  //===============================================================================================  
  // Start of Initial BH1750
  //===============================================================================================
  //===============================================================================================
  // BH1750  
  //===============================================================================================
  // ADDR:LOW  = 0x23 
  // ADDR:HIGH = 0x5C
  //===============================================================================================
  Wire.beginTransmission(0x23);                                                                   // BH1750 Slave Address = 0x23(ADDR:LOW)
  //===============================================================================================
  if(Wire.endTransmission () == 0)
  {
    //=============================================================================================
    serialDebug.println(F("Initial I2C BH1750(0x23)...Start"));
    //=============================================================================================
    //=============================================================================================
    lightMeter.begin(BH1750::CONTINUOUS_HIGH_RES_MODE, 0x23, &Wire);                              // 0...56412.5 Lux
    //=============================================================================================
    serialDebug.println(F("Initial I2C BH1750(0x23)...Complete"));
    //=============================================================================================
    delay(500);
    //=============================================================================================
    if(lightMeter.measurementReady(true))
    {
      //===========================================================================================
      bh1750Lux = lightMeter.readLightLevel();                                                    // (Lux)
      //===========================================================================================
      //===========================================================================================
      serialDebug.print("I2C BH1750(0x23) Light = ");
      serialDebug.println(bh1750Lux,1);
      //===========================================================================================
    }
    //=============================================================================================
    serialDebug.println(F("========================================================================="));
    serialDebug.println(F("I2C BH1750(0x23) : Light...Install"));
    serialDebug.println(F("========================================================================="));
    //=============================================================================================
  }
  else
  {
    //=============================================================================================
    Wire.beginTransmission(0x5C);                                                                 // BH1750 Slave Address = 0x5C(ADDR:HIGH)
    //=============================================================================================
    if(Wire.endTransmission () == 0)
    {
      //===========================================================================================
      serialDebug.println(F("Initial I2C BH1750(0x5C)...Start"));
      //===========================================================================================
      lightMeter.begin(BH1750::CONTINUOUS_HIGH_RES_MODE, 0x5C, &Wire);                            // 0...56412.5 Lux
      //===========================================================================================
      serialDebug.println(F("Initial I2C BH1750(0x5C)...Complete"));
      //===========================================================================================
      delay(500);
      //===========================================================================================
      if(lightMeter.measurementReady(true))
      {
        //=========================================================================================
        bh1750Lux = lightMeter.readLightLevel();                                                  // (Lux)
        //=========================================================================================
        //=========================================================================================
        serialDebug.print("I2C BH1750(0x5C) Light = ");
        serialDebug.println(bh1750Lux,1);
        //=========================================================================================
      }
      //=========================================================================================
      serialDebug.println(F("========================================================================="));
      serialDebug.println(F("I2C BH1750(0x5C) : Light...Install"));
      serialDebug.println(F("========================================================================="));
      //===========================================================================================
    }
    else
    {
      //===========================================================================================
      serialDebug.println(F("I2C BH1750(0x23,0x5C)...Not Install"));
      //===========================================================================================
      bh1750Lux = err_bh1750Light;
      //===========================================================================================
      serialDebug.print("I2C BH1750(0x5c) Light = ");
      serialDebug.println(bh1750Lux,1);
      //===========================================================================================
    }
  }
  //===============================================================================================
  //===============================================================================================  
  // End of Initial BH1750
  //===============================================================================================
  //===============================================================================================
  serialDebug.println(F("========================================================================="));
  serialDebug.println("ET-ESP32(WROVER)RS485 V3.....Ready");
  serialDebug.println(F("========================================================================="));
  serialDebug.println();
  //===============================================================================================
}

void loop() 
{
  //===============================================================================================
  if((millis() - lastGetI2CTime) > 10000ul)                                                       // 10-Second
  {
    //=============================================================================================
    OnLed();
    //OnBuzzer();
    //=============================================================================================
    
    //=============================================================================================
    // Start of Search & Read SHT31 Sensor  
    //=============================================================================================
    // ADDR:LOW  = 0x44 
    // ADDR:HIGH = 0x45
    //=============================================================================================
    Wire.beginTransmission(0x44);                                                                 // SHT31 Slave Address = 0x44,0x45
    //=============================================================================================
    if(Wire.endTransmission () == 0)
    {
      //===========================================================================================
      sht31Temperature = sht31.readTemperature();                                                 // (-)55...(+)125
      sht31Humidity = sht31.readHumidity();                                                       // 0..100
      //===========================================================================================
      serialDebug.print("SHT31(0x44) Temperature = ");
      serialDebug.print(sht31Temperature,1);
      serialDebug.print(" : Humidity = ");
      serialDebug.println(sht31Humidity,1);
      //===========================================================================================
    }
    else
    {
      //===========================================================================================
      Wire.beginTransmission(0x45);                                                               // SHT31 Slave Address = 0x44,0x45
      //===========================================================================================
      if(Wire.endTransmission () == 0)
      {
        //=========================================================================================
        sht31Temperature = sht31.readTemperature();                                               // (-)55...(+)125
        sht31Humidity = sht31.readHumidity();                                                     // 0..100
        //=========================================================================================
        serialDebug.print("SHT31(0x45) Temperature = ");
        serialDebug.print(sht31Temperature,1);
        serialDebug.print(" : Humidity = ");
        serialDebug.println(sht31Humidity,1);
        //=========================================================================================
      }
      else
      {
        //=========================================================================================
        sht31Temperature = err_sht31Temperature;
        sht31Humidity = err_sht31Humidity;
        //=========================================================================================
        serialDebug.println(F("SHT31(0x44,0x45)...Not Install"));
        //=========================================================================================
      }  
    }
    //=============================================================================================
    // End of Search & Read SHT31 Sensor  
    //=============================================================================================

    //=============================================================================================
    // Start of Search & Read BH1750  
    //=============================================================================================
    // ADDR:LOW  = 0x23 
    // ADDR:HIGH = 0x5C
    //=============================================================================================
    Wire.beginTransmission(0x23);                                                                 // BH1750 Slave Address = 0x23(ADDR:LOW)
    //=============================================================================================
    if(Wire.endTransmission () == 0)
    {
      //===========================================================================================
      bh1750Lux = lightMeter.readLightLevel();                                                    // Lux
      //===========================================================================================
      serialDebug.print(F("BH1750(0x23) Light = "));
      serialDebug.println(bh1750Lux,1);
      //===========================================================================================
    }
    else
    {
      //===========================================================================================
      Wire.beginTransmission(0x5C);                                                               // BH1750 Slave Address = 0x5C(ADDR:HIGH)
      //===========================================================================================
      if(Wire.endTransmission () == 0)
      {
        //=========================================================================================
        bh1750Lux = lightMeter.readLightLevel();                                                  // Lux
        //=========================================================================================
        serialDebug.print(F("BH1750(0x5C) Light = "));
        serialDebug.println(bh1750Lux,1);
        //=========================================================================================
      }
      else
      {
        //=========================================================================================
        bh1750Lux = err_bh1750Light;
        //=========================================================================================
        serialDebug.println(F("BH1750(0x23,0x5C)...Not Install"));
        //=========================================================================================
      }
    }
    //=============================================================================================
    // End of Search & Read BH1750  
    //=============================================================================================
  
    //=============================================================================================
    OffLed();  
    //OffBuzzer();
    //=============================================================================================
    lastGetI2CTime = millis();
    //=============================================================================================
  }
  //===============================================================================================
}



